## apps/terrarium/Groupe_B/Kconfig
```kconfig
#
# For a description of the syntax of this configuration file,
# see misc/tools/kconfig-language.txt.
#

config APPLICATION_GROUPE_B
	bool "Groupe B application"
	default n
	---help---
		Enable the Groupe B application

if APPLICATION_GROUPE_B

config APPLICATION_GROUPE_B_PROGNAME
	string "Program name"
	default "Application du groupe B"
	depends on BUILD_KERNEL
	---help---
		Basic application for terrarium students.
endif
```

## apps/terrarium/Groupe_G/Kconfig
```kconfig
#
# For a description of the syntax of this configuration file,
# see misc/tools/kconfig-language.txt.
#

config APPLICATION_GROUPE_G
	bool "Application du controle du LCD I2C 0 et PWM 0"
	default n
	---help---
		Enable the Groupe A application

if APPLICATION_GROUPE_G

config APPLICATION_GROUPE_G_PROGNAME
	string "pwmi2c"
	default "Application du controle du LCD I2C 0 et PWM 0"
	depends on BUILD_KERNEL
	---help---
		Basic application for terrarium students.
endif
```

## apps/terrarium/Groupe_H/Kconfig
```kconfig
#
# For a description of the syntax of this configuration file,
# see misc/tools/kconfig-language.txt.
#

config APPLICATION_GROUPE_A
	bool "Groupe A application"
	default n
	---help---
		Enable the Groupe A application

if APPLICATION_GROUPE_A

config APPLICATION_GROUPE_A_PROGNAME
	string "Program name"
	default "Application du groupe A"
	depends on BUILD_KERNEL
	---help---
		Basic application for terrarium students.
endif
```

## apps/terrarium/Kconfig
```kconfig
#
# For a description of the syntax of this configuration file,
# see misc/tools/kconfig-language.txt.
#

menu "Applications du Groupe A"
source "$APPSDIR/terrarium/Groupe_A/Kconfig"
endmenu

menu "Applications du Groupe B"
source "$APPSDIR/terrarium/Groupe_B/Kconfig"
endmenu

menu "Applications du Groupe D"
source "$APPSDIR/terrarium/Groupe_D/Kconfig"
endmenu

menu "Applications du Groupe E"
source "$APPSDIR/terrarium/Groupe_E/Kconfig"
endmenu

menu "Applications du Groupe F"
source "$APPSDIR/terrarium/Groupe_F/Kconfig"
endmenu

menu "Applications du Groupe G"
source "$APPSDIR/terrarium/Groupe_G/Kconfig"
endmenu

menu "Applications du Groupe H"
source "$APPSDIR/terrarium/Groupe_H/Kconfig"
endmenu

menu "Applications du professeur"
source "$APPSDIR/terrarium/teacher/Kconfig"
endmenu
```

## myapp/Groupe_D/Kconfig
```kconfig
#
# For a description of the syntax of this configuration file,
# see misc/tools/kconfig-language.txt.
#

config APPLICATION_GROUPE_D
	bool "Groupe D application"
	default n
	---help---
		Enable the Groupe D application

if APPLICATION_GROUPE_D

config APPLICATION_GROUPE_D_PROGNAME
	string "Program name"
	default "Application du groupe D"
	depends on BUILD_KERNEL
	---help---
		Basic application for terrarium students.
endif
```

## myapp/Groupe_E/Kconfig
```kconfig
#
# For a description of the syntax of this configuration file,
# see misc/tools/kconfig-language.txt.
#

config APPLICATION_GROUPE_E
	bool "Groupe E application"
	default n
	---help---
		Enable the Groupe E application

if APPLICATION_GROUPE_E

config APPLICATION_GROUPE_E_PROGNAME
	string "Program name"
	default "Application du groupe E"
	depends on BUILD_KERNEL
	---help---
		Basic application for terrarium students.
endif
```

## myapp/Groupe_F/Kconfig
```kconfig
#
# For a description of the syntax of this configuration file,
# see misc/tools/kconfig-language.txt.
#

config APPLICATION_GROUPE_F
	bool "Groupe F application"
	default n
	---help---
		Enable the Groupe F application

if APPLICATION_GROUPE_F

config APPLICATION_GROUPE_F_PROGNAME
	string "Program name"
	default "Application du groupe F"
	depends on BUILD_KERNEL
	---help---
		Basic application for terrarium students.
endif
```

## myapp/Kconfig
```kconfig
#
# For a description of the syntax of this configuration file,
# see misc/tools/kconfig-language.txt.
#

menu "Applications du Groupe A"
source "$APPSDIR/Groupe_A/Kconfig"
endmenu

menu "Applications du Groupe B"
source "$APPSDIR/Groupe_B/Kconfig"
endmenu

menu "Applications du Groupe D"
source "$APPSDIR/Groupe_D/Kconfig"
endmenu

menu "Applications du Groupe E"
source "$APPSDIR/Groupe_E/Kconfig"
endmenu

menu "Applications du Groupe F"
source "$APPSDIR/Groupe_F/Kconfig"
endmenu

menu "Applications du Groupe G"
source "$APPSDIR/Groupe_G/Kconfig"
endmenu

menu "Applications du Groupe H"
source "$APPSDIR/Groupe_H/Kconfig"
endmenu

menu "Applications du professeur"
source "$APPSDIR/Tibo/Kconfig"
endmenu
```

## myapp/Tibo/Kconfig
```kconfig
#
# For a description of the syntax of this configuration file,
# see misc/tools/kconfig-language.txt.
#

menu "Teacher application test1"
source "$APPSDIR/Tibo/tibo_test1/Kconfig"
endmenu
```

## myapp/Tibo/tibo_test1/Kconfig
```kconfig
#
# For a description of the syntax of this configuration file,
# see misc/tools/kconfig-language.txt.
#

config APPLICATION_TIBO_TEST1
	bool "Teacher application test1"
	default n
	---help---
		Enable the Teacher application test1

if APPLICATION_TIBO_TEST1

config APPLICATION_TIBO_TEST1_STACKSIZE
        int "test1 stack size"
        default 1024

config APPLICATION_TIBO_TEST1_USE_ADC
        bool "test1 uses ADC"
        default n

config APPLICATION_TIBO_TEST1_USE_I2C
        bool "test1 uses I2C"
        default n

config APPLICATION_TIBO_TEST1_USE_SPI
        bool "test1 uses SPI"
        default n

# not sure about this at the moment...
#	depends on BUILD_KERNEL

	---help---
		Basic application for terrarium students.
endif
```

## nuttx/configs/sam4s-xplained/Kconfig
```kconfig
#
# For a description of the syntax of this configuration file,
# see misc/tools/kconfig-language.txt.
#

if ARCH_BOARD_SAM4S_XPLAINED

config SAM4S_XPLAINED_CDCACM_DEVMINOR
	int "CDC/ACM Device Minor"
	default 0
	depends on SAM34_UDP && USBDEV && CDCACM

config SAM4S_XPLAINED_SCHED_TIMER_DEVPATH
    string "Scheduler Timer Device Path"
	default "/dev/rtt0"
	depends on TIMER && SYSTEMTICK_EXTCLK

config SAM4S_XPLAINED_CPULOAD_TIMER_DEVPATH
    string "CPU Load Timer Device Path"
	default "/dev/tc0"
	depends on TIMER && SCHED_CPULOAD && SCHED_CPULOAD_EXTCLK


config SAM4S_XPLAINED_CHANNEL
	int "PWM channel number"
	default 0 if SAM34_PWM_CHAN0
	default 1 if SAM34_PWM_CHAN1
	default 2 if SAM34_PWM_CHAN2
	default 3 if SAM34_PWM_CHAN3
	range 0 3
	depends on PWM && SAM34_PWM
	---help---
		Selects the PWM channel number that will be used to perform the PWM
		test.  See apps/examples/pwm.

endif
```
